## conf/layer.conf
```bitbake
#
# layer profile
#

BBPATH .= ":${LAYERDIR}"

BBFILES += "${LAYERDIR}/recipes-*/*/*.bb \
        ${LAYERDIR}/recipes-*/*/*.bbappend"

BBFILE_COLLECTIONS += "emlinux-ext-riscv"
BBFILE_PATTERN_emlinux-ext-riscv = "^${LAYERDIR}/"
BBFILE_PRIORITY_emlinux-ext-riscv = "30"

LAYERSERIES_COMPAT_emlinux-ext-riscv = "next"

LAYERDIR_emlinux-ext-riscv = "${LAYERDIR}"
```

## conf/machine/qemu-riscv64.conf
```bitbake
#
# qemu-riscv64  profile
# Copyright (c) Cybertrust Japan Co., Ltd.
#
# Authors:
#  Masahiko Kimoto <masahiko.kimoto@miraclelinux.com>
#
# SPDX-License-Identifier: MIT
#

DISTRO_ARCH ?= "riscv64"

KERNEL_NAME ?= "riscv64"

IMAGE_FSTYPES ?= "ext4"
ROOTFS_EXTRA ?= "128"

QEMU_ARCH ?= "riscv64"
QEMU_MACHINE ?= "virt"
QEMU_CPU ?= "rv64gcsu-v1.10.0"

MACHINE_SERIAL ?= "ttyS0"
BAUDRATE_TTY ?= "115200"

# when enabled, rebuilding the initramfs fails with out-of-space error
IMAGE_INSTALL:remove = "enable-fsck"
```
